## esp_idf/Julelys/components/led_controller/Kconfig
```kconfig
menu "Julelys LED"

    config JULELYS_NUMBER_OF_STRINGS
        int "Number of strings"
        range 1 8
        default 8
        help
            Number of LED strings, driven on mux channels 0 and up (the first
            JST outputs). Fewer strings means a shorter refresh per frame.
            The manager must be started with the same --matrix-width.

    config JULELYS_LEDS_PER_STRING
        int "LEDs per string"
        range 1 360
        default 55
        help
            Number of LEDs on each of the 8 strings. The manager must be
            started with the same --matrix-height. Each stream packet is
            4 + 4 * this many bytes, and 360 keeps it inside the MTU.

    choice JULELYS_LED_TYPE
        prompt "LED chip type"
        default JULELYS_LED_TYPE_SK6812
        help
            The LED chip on the strings. Frames always arrive as RGBW; on RGB
            chips the white channel is folded into red, green and blue.

        config JULELYS_LED_TYPE_SK6812
            bool "SK6812 RGBW"

        config JULELYS_LED_TYPE_WS2812B
            bool "WS2812B RGB"
    endchoice

    choice JULELYS_LED_COLOR_ORDER
        prompt "WS2812B color order"
        depends on JULELYS_LED_TYPE_WS2812B
        default JULELYS_LED_COLOR_ORDER_GRB
        help
            WS2812B is normally GRB, but some fairy light strings are RGB.
            If red and green are swapped, pick the other one.

        config JULELYS_LED_COLOR_ORDER_GRB
            bool "GRB"

        config JULELYS_LED_COLOR_ORDER_RGB
            bool "RGB"
    endchoice

endmenu
```
